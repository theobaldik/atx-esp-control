## main/Kconfig
```kconfig
# SPDX-License-Identifier: MIT

menu "ATX ESP Control Configuration"

    menu "GPIO Settings"

    config ATX_ESP_GPIO_PS_ON
        int "GPIO PS_ON"
        default 3
        range 0 39
        help
            GPIO output connected to the PS_ON PSU pin.
            This is used to control the PSU power state.
            When pulled Low, the PSU turns on, when High or floating, the PSU turns off.

    config ATX_ESP_GPIO_PWR_SW
        int "GPIO PWR_SW"
        default 4
        range 0 39
        help
            GPIO input connected to the power button.
            Must be set to an RTC GPIO pin in order to work in deep sleep mode.

    config ATX_ESP_GPIO_MB_ON
        int "GPIO MB_ON"
        default 2
        range 0 39
        help
            GPIO input connected to the controlled motherboard.
            The motherboard shall output ~3.3V to this pin when the system is running
            and 0V (floating) when the system is in a soft-off state.
            Must be set to an RTC GPIO pin in order to work in deep sleep mode.

    config ATX_ESP_GPIO_MB_ACPI
        int "GPIO MB_ACPI"
        default 10
        range 0 39
        help
            GPIO output connected to the controlled motherboard pin configured
            for ACPI power state indication.
            This is used to signal the motherboard to enter a soft-off state.

    endmenu

endmenu
```

## sdkconfig.defaults
```kconfig
# Default configuration for all chips

# Skip validation to speed up wake up
CONFIG_BOOTLOADER_SKIP_VALIDATE_IN_DEEP_SLEEP=y

# Turn off bootloader logging
CONFIG_BOOTLOADER_COMPILER_OPTIMIZATION_PERF=y
CONFIG_BOOTLOADER_LOG_LEVEL_NONE=y
CONFIG_BOOTLOADER_LOG_LEVEL=0
CONFIG_COMPILER_OPTIMIZATION_PERF=y

# Turn off console output
CONFIG_ESP_CONSOLE_NONE=y
CONFIG_ESP_CONSOLE_SECONDARY_NONE=y

# Turn off logging
CONFIG_LOG_DEFAULT_LEVEL_NONE=y
CONFIG_LOG_DEFAULT_LEVEL=0

CONFIG_ESP_SYSTEM_PANIC_SILENT_REBOOT=y
```

## sdkconfig.defaults.esp32
```kconfig
# Default ATX-ESP Control config for ESP32 chips

# GPIO Settings
CONFIG_ATX_ESP_GPIO_PS_ON=27
CONFIG_ATX_ESP_GPIO_PWR_SW=33
CONFIG_ATX_ESP_GPIO_MB_ON=32
CONFIG_ATX_ESP_GPIO_MB_ACPI=13
```

## sdkconfig.defaults.esp32c3
```kconfig
# Default ATX-ESP Control config for ESP32-C3 chips

# GPIO Settings
CONFIG_ATX_ESP_GPIO_PWR_SW=0
CONFIG_ATX_ESP_GPIO_MB_ON=1
CONFIG_ATX_ESP_GPIO_PS_ON=3
CONFIG_ATX_ESP_GPIO_MB_ACPI=10
```
